## config/west.yml
```yaml
manifest:
  remotes:
    - name: zmkfirmware
      url-base: https://github.com/zmkfirmware
  #additional module
    - name: petejohanson
      url-base: https://github.com/petejohanson
    - name: gpeye
      url-base: https://github.com/GPeye
    - name: mctechnology17
      url-base: https://github.com/mctechnology17
    - name: kevinpastor
      url-base: https://github.com/kevinpastor
    - name: m165437
      url-base: https://github.com/M165437
    - name: s6t
      url-base: https://github.com/s6t
    - name: infely
      url-base: https://github.com/infely
    - name: penguinchat
      url-base: https://github.com/penguinchat
    - name: englmaxi
      url-base: https://github.com/englmaxi
  projects:
    - name: zmk
      remote: zmkfirmware
      revision: 
      import: app/west.yml
  #additional module
    - name: hammerbeam-slideshow
      remote: gpeye
      revision: 
    - name: zmk-nice-oled
      remote: mctechnology17
      revision: 
    - name: nice-view-elemental
      remote: kevinpastor
      revision: 
    - name: nice-view-gem
      remote: m165437
      revision: 
    - name: zmk-shield-nice-view-cats
      remote: s6t
      revision: 
    - name: nice-view-battery
      remote: infely
      revision: 
    - name: zmk-dongle-screen
      remote: penguinchat
      revision: 
    - name: zmk-for-PandaKB.com-
      remote: penguinchat
      revision: 
    - name: zmk-dongle-display
      remote: englmaxi
      revision: 
  self:
    path: config
```
